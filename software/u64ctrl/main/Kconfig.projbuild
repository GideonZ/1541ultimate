## software/u64ctrl/main/Kconfig.projbuild
```kconfig
config ULTIMATE_PROVIDER_CONTROL
    bool "Experimental provider control delivery"
    default n
    help
        Build the optional bounded UART control worker for local validation.
        TLS is unavailable without separate backend selection and provisioning.
        This does not enable HTTPS or change the C64 command interface.

config ULTIMATE_PROVIDER_TLS
    bool "Experimental owner TLS backend"
    depends on ULTIMATE_PROVIDER_CONTROL
    depends on !ESP_TIME_FUNCS_USE_NONE
    select MBEDTLS_HAVE_TIME
    select MBEDTLS_HAVE_TIME_DATE
    default n
    help
        Requires an explicit TLS_STREAM_ROOT and boot-time roots, clock and
        entropy policy. No default provisioning or automatic HTTP activation.

config ULTIMATE_PROVIDER_SOURCES
    bool "Experimental production TLS sources"
    depends on ULTIMATE_PROVIDER_TLS
    select MBEDTLS_CERTIFICATE_BUNDLE
    default n
    help
        Select the pinned repository root bundle, configured ordinary SNTP with
        expiry/jump checks and Wi-Fi RF entropy lifecycle notifications.
        SNTP is unauthenticated. This does not register the native HTTPS client.

menu "Example Configuration"

    orsource "$IDF_PATH/examples/common_components/env_caps/$IDF_TARGET/Kconfig.env_caps"

    config BLINK_GPIO
        int "Blink GPIO number"
        range ENV_GPIO_RANGE_MIN ENV_GPIO_OUT_RANGE_MAX
        default 5 if IDF_TARGET_ESP32
        default 18 if IDF_TARGET_ESP32S2
        default 48 if IDF_TARGET_ESP32S3
        default 8
        help
            GPIO number (IOxx) to blink on and off the LED.
            Some GPIOs are used for other purposes (flash connections, etc.) and cannot be used to blink.

    config BLINK_PERIOD
        int "Blink period in ms"
        range 10 3600000
        default 1000
        help
            Define the blinking period in milliseconds.

endmenu
```

## target/esp32/test_provider_runtime/sdkconfig.defaults
```kconfig
CONFIG_IDF_TARGET="esp32s3"
CONFIG_ESPTOOLPY_FLASHSIZE_4MB=y
CONFIG_ETH_USE_OPENETH=y
CONFIG_ETH_USE_SPI_ETHERNET=n
CONFIG_ESP_MAIN_TASK_STACK_SIZE=12288
CONFIG_MBEDTLS_HAVE_TIME=y
CONFIG_MBEDTLS_HAVE_TIME_DATE=y
CONFIG_MBEDTLS_SSL_PROTO_TLS1_3=n
CONFIG_MBEDTLS_SSL_IN_CONTENT_LEN=16384
CONFIG_MBEDTLS_SSL_OUT_CONTENT_LEN=4096
CONFIG_LWIP_SO_LINGER=y
```
