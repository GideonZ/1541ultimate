// The WiFi TX path under load: lwIP's real TCP and UDP (the firmware's windows and
// buffers, lwip_sim/) sends over a netif whose output is the real wifi_tx_packet on the real DmaUART
// (dma_uart.cc, its TX-done interrupt included) and cmd_buffer.c, with the pool of 12 buffers, over
// the register model of uart_host/dma_uart_regs.h. Time is simulated: the UART moves one frame in
// the time its bytes take at 6.67 Mbaud (about 2.30 ms for 1514 bytes), a fake peer takes each frame
// when it has left the UART and answers it after the round trip time, and the lwIP timers run on the
// simulated clock. Nothing is measured in real time; the CPU time of the Nios is not modelled.
//
// The old behaviour (wifi_tx_wait_legacy: wait for a buffer up to 5 s, the tcpip thread blocked: the
// clock moves with the UART, and nothing else of lwIP runs: not the peer's answers, nor the timers)
// is run beside the new one, on the same load.
//
//   WtxSimThroughput  bytes delivered in 10 s, old against new, RTT 5, 30 and 60 ms
//   WtxSimStall       the module drain stops for 3 s: lwIP responsiveness and the resume
//   WtxSimWake        nothing in flight, the pool taken by other frames: only the wake restarts TCP
//
// -DWTX_NEW_IS_LEGACY puts the old function in the place of the new one (a red model).

#include <queue>
#include <vector>
#include <stdio.h>
#include <string.h>
#include <stdlib.h>
#include "../../usb/tests/host_test/host_test.h"
extern "C" {
#include "lwip/init.h"
#include "lwip/netif.h"
#include "lwip/ip4.h"
#include "lwip/ip4_addr.h"
#include "lwip/tcp.h"
#include "lwip/udp.h"
#include "lwip/pbuf.h"
#include "lwip/timeouts.h"
#include "lwip/priv/tcp_priv.h"
}
#include "dma_uart.h" // the generated copy, with the register proxies
#include "net_counters.h"
#include "fifo_queues.h"
#include "fw_err_need_sched.h" // ERR_NEED_SCHED, from the firmware's arch/sys_arch.h

// ---- what wifi.cc uses of the rest of the firmware ------------------------------------------
#define CMD_SEND_PACKET 0x08
typedef struct {            // rpc_calls.h
    uint8_t command;
    uint8_t thread;
    uint16_t sequence;
} rpc_header_t;
typedef struct {
    rpc_header_t hdr;
    uint32_t length;
    char data;
} rpc_send_eth_req;
const char *no_wifi_buf = "*** NO BUFFER TO TRANSMIT ANYTHING.\n";
enum { eWifi_NotConnected, eWifi_Connected };
struct { int state; int getState() { return state; } } wifi;
struct { DmaUART *uart; } esp32;
#define WIFI_TX_RESERVE 2 // wifi_cmd.h, checked by the Makefile

struct tcpip_callback_msg { int unused; };
typedef void (*tcpip_callback_fn)(void *ctx);
namespace {
struct tcpip_callback_msg the_msg;
tcpip_callback_fn registered_fn;
bool txnow_posted;            // the interrupt asked the tcpip thread for the callback
int txnow_posts;
int64_t now_us;               // the simulated clock, never reset: the lwIP timers keep their times
}
extern "C" {
TickType_t xTaskGetTickCount(void) { return (TickType_t)(now_us / 5000); }
u32_t sys_now(void) { return (u32_t)(now_us / 1000); }
}
struct tcpip_callback_msg *tcpip_callbackmsg_new(tcpip_callback_fn fn, void *) { registered_fn = fn; return &the_msg; }
err_t tcpip_callbackmsg_trycallback_fromisr(struct tcpip_callback_msg *)
{
    txnow_posted = true;
    txnow_posts++;
    return ERR_OK;
}

#include "wifi_tx_extract.inc" // the code under test (generated by the Makefile)
#include "wifi_tx_packet.inc"
#define wifi_tx_packet wifi_tx_packet_legacy
#include "wifi_tx_legacy.inc"
#undef wifi_tx_packet

extern "C" {
void ioWrite8(volatile uint8_t *, uint8_t) { }
uint8_t ioRead8(volatile uint8_t *) { return 0; }
void install_high_irq(int, irq_function_t, void *) { }
}
void dump_hex_relative(const void *, int) { }

namespace {

const int64_t INF = INT64_MAX;
const int64_t SEC = 1000000;
const int64_t TICK = 5000; // the host tick, 5 ms

typedef err_t (*tx_fn_t)(void *, void *, int);
#ifdef WTX_NEW_IS_LEGACY
tx_fn_t const new_model = wifi_tx_packet_legacy;
#else
tx_fn_t const new_model = wifi_tx_packet;
#endif
tx_fn_t const old_model = wifi_tx_packet_legacy;

enum EvType { EV_ACK_IN, EV_TIMER, EV_PING, EV_TXNOW, EV_BURST, EV_APP, EV_UDP };
struct Ev {
    int64_t t;
    uint64_t n;
    EvType type;
    std::vector<uint8_t> pkt;
    bool operator<(const Ev &o) const { return t != o.t ? t > o.t : n > o.n; }
};

const uint32_t DEV_IP = 0x0A000002, PEER_IP = 0x0A000009; // 10.0.0.2, 10.0.0.9 (host order)
const uint16_t PEER_PORT = 80; // flow i connects to PEER_PORT + i
const int MAX_FLOWS = 2;

// One TCP connection: the device's end, and the peer's
struct Flow {
    struct tcp_pcb *pcb;
    bool app_on;
    bool connected;
    uint16_t dev_port;
    uint32_t rcv_nxt;
    uint64_t delivered;
    std::vector<int64_t> accept_times;   // when wifi_tx_packet took a data frame of this flow
};

// The state of one run
struct Sim {
    // the device
    command_buf_context_t ctx;
    dma_uart_t regs;
    DmaUART *uart;
    struct netif nif;
    Flow flow[MAX_FLOWS];
    int nflows;
    struct udp_pcb *upcb;
    tx_fn_t tx;
    uint8_t chunk[1460];
    // time
    std::priority_queue<Ev> q;
    uint64_t evn;
    int64_t tx_done_at;          // the frame on the wire leaves the module at this time
    int64_t stall_from, stall_to; // the module does not drain in [from, to)
    int64_t rtt_us;
    int pushes_seen;
    uint8_t *cur_frame;
    int cur_len;
    // the peer
    uint32_t peer_snd;
    int tcp_frames, udp_frames, dup_segments;
    // what happened to lwIP
    int64_t blocked_us, longest_block_us;
    int64_t ping_max_us;
    int refused, accepted, tcp_errors;
    int64_t udp_every_us;        // other traffic: a datagram this often (0: none)
};
Sim S;

// ---- the clock, the events ------------------------------------------------------------------
void post(int64_t t, EvType type, const std::vector<uint8_t> &pkt = std::vector<uint8_t>())
{
    Ev e;
    e.t = t;
    e.n = S.evn++;
    e.type = type;
    e.pkt = pkt;
    S.q.push(e);
}

void do_txdone();
void app_send(Flow *f);

// What the TX-done interrupt does, and the frame it starts
void run_isr()
{
    for (int guard = 0; guard < 100 && (dmauart_hw().status() & 7); guard++) {
        DmaUART::DmaUartInterrupt(S.uart);
    }
    if (dmauart_hw().tx_pushes > S.pushes_seen) { // the interrupt started a frame
        S.pushes_seen = dmauart_hw().tx_pushes;
        S.cur_frame = dmauart_hw().tx_addr;
        S.cur_len = dmauart_hw().tx_len;
        // Bytes on the wire: the frame, a SLIP end, and 0.78% escapes, 10 bits each at 6.667 Mbaud
        int64_t wire = (int64_t)((S.cur_len * 1.0078 + 1) * 1.5);
        int64_t t0 = now_us;
        if (t0 >= S.stall_from && t0 < S.stall_to) {
            t0 = S.stall_to; // the module holds RTS: the frame starts when it drains again
        }
        int64_t end = t0 + wire;
        if (t0 < S.stall_from && end > S.stall_from) {
            end += S.stall_to - S.stall_from; // held in the middle of the frame
        }
        S.tx_done_at = end;
    }
    if (txnow_posted) { // the interrupt's post to the tcpip thread
        txnow_posted = false;
        post(now_us, EV_TXNOW);
    }
}

uint16_t be16(const uint8_t *p) { return (uint16_t)((p[0] << 8) | p[1]); }
uint32_t be32(const uint8_t *p) { return ((uint32_t)p[0] << 24) | (p[1] << 16) | (p[2] << 8) | p[3]; }
void put16(uint8_t *p, uint16_t v) { p[0] = v >> 8; p[1] = v & 0xFF; }
void put32(uint8_t *p, uint32_t v) { put16(p, v >> 16); put16(p + 2, v & 0xFFFF); }

// An IPv4 + TCP packet from the peer to the device
std::vector<uint8_t> peer_segment(uint16_t peer_port, uint16_t dev_port, uint8_t flags, uint32_t seq, uint32_t ack, bool mss_option)
{
    int tcp_len = mss_option ? 24 : 20;
    std::vector<uint8_t> p(20 + tcp_len, 0);
    p[0] = 0x45;
    put16(&p[2], (uint16_t)p.size());
    p[8] = 64;
    p[9] = 6;
    put32(&p[12], PEER_IP);
    put32(&p[16], DEV_IP);
    uint8_t *t = &p[20];
    put16(t, peer_port);
    put16(t + 2, dev_port);
    put32(t + 4, seq);
    put32(t + 8, ack);
    t[12] = (uint8_t)(tcp_len / 4 << 4);
    t[13] = flags;
    put16(t + 14, 65535);
    if (mss_option) {
        t[20] = 2; t[21] = 4; put16(t + 22, 1460);
    }
    return p;
}

// A frame has left the module and reaches the peer
void peer_receive(const uint8_t *frame, int len)
{
    const uint8_t *ip = frame + 14;
    int iplen = be16(ip + 2);
    if (len < 34 || ip[0] != 0x45 || (int)(len - 14) < iplen) {
        return;
    }
    if (ip[9] == 17) {
        S.udp_frames++;
        return;
    }
    if (ip[9] != 6) {
        return;
    }
    const uint8_t *t = ip + 20;
    int hl = (t[12] >> 4) * 4;
    int plen = iplen - 20 - hl;
    uint32_t seq = be32(t + 4);
    uint8_t flags = t[13];
    uint16_t sport = be16(t), dport = be16(t + 2);
    if (dport < PEER_PORT || dport >= PEER_PORT + S.nflows) {
        return;
    }
    Flow &f = S.flow[dport - PEER_PORT];
    f.dev_port = sport;
    if (flags & 0x02) { // SYN: answered with SYN+ACK
        f.rcv_nxt = seq + 1;
        post(now_us + S.rtt_us, EV_ACK_IN, peer_segment(dport, sport, 0x12, S.peer_snd - 1, f.rcv_nxt, true));
        return;
    }
    if (plen <= 0) {
        return;
    }
    S.tcp_frames++;
    if (seq == f.rcv_nxt) {
        f.rcv_nxt += plen;
        f.delivered += plen;
    } else {
        S.dup_segments++; // out of order or a retransmission of what the peer has: not taken
    }
    post(now_us + S.rtt_us, EV_ACK_IN, peer_segment(dport, sport, 0x10, S.peer_snd, f.rcv_nxt, false));
}

// The frame on the wire is done: the module has it, the interrupt frees the buffer and starts the next
void do_txdone()
{
    S.tx_done_at = INF;
    peer_receive(S.cur_frame + 8, S.cur_len - 8); // rpc_send_eth_req: header, length, then the frame
    dmauart_hw().tx_complete();
    run_isr();
}

// A wait of 'ticks' for a TX buffer in the tcpip thread (the old wifi_tx_packet): lwIP does nothing
// meanwhile, the UART goes on
void block(QueueHandle_t q, TickType_t ticks)
{
    Fifo *f = (Fifo *)q;
    int64_t from = now_us;
    int64_t deadline = now_us + (int64_t)ticks * TICK;
    while (f->q.empty()) {
        if (S.tx_done_at > deadline) {
            now_us = deadline;
            break;
        }
        if (S.tx_done_at > now_us) {
            now_us = S.tx_done_at;
        }
        do_txdone();
    }
    S.blocked_us += now_us - from;
    if (now_us - from > S.longest_block_us) {
        S.longest_block_us = now_us - from;
    }
}

// ---- the device's netif ---------------------------------------------------------------------
err_t sim_linkoutput(struct netif *, struct pbuf *p)
{
    static uint8_t frame[1600];
    int len = 14 + p->tot_len;
    if (len > (int)sizeof(frame)) {
        return ERR_BUF;
    }
    memset(frame, 0, 14);
    frame[12] = 0x08;
    pbuf_copy_partial(p, frame + 14, p->tot_len, 0);
    err_t err = S.tx(NULL, frame, len);
    if (err == ERR_OK) {
        S.accepted++;
        const uint8_t *ip = frame + 14;
        if (ip[9] == 6 && be16(ip + 2) > 20 + ((ip[20 + 12] >> 4) * 4)) {
            uint16_t dport = be16(ip + 20 + 2);
            if (dport >= PEER_PORT && dport < PEER_PORT + S.nflows) {
                S.flow[dport - PEER_PORT].accept_times.push_back(now_us);
            }
        }
    } else if (err == ERR_MEM) {
        S.refused++;
    }
    run_isr(); // wifi_tx_packet enabled the TX interrupt
    return err;
}
err_t sim_output(struct netif *n, struct pbuf *p, const ip4_addr_t *) { return sim_linkoutput(n, p); }
err_t sim_netif_init(struct netif *n)
{
    n->name[0] = 'w';
    n->name[1] = 'f';
    n->output = sim_output;
    n->linkoutput = sim_linkoutput;
    n->mtu = 1500;
    n->flags = NETIF_FLAG_BROADCAST | NETIF_FLAG_LINK_UP;
    return ERR_OK;
}

// ---- the application: sends as fast as lwIP lets it -----------------------------------------
void app_send(Flow *f)
{
    if (!f->app_on || !f->pcb) {
        return;
    }
    while (tcp_sndbuf(f->pcb) >= sizeof(S.chunk)) {
        if (tcp_write(f->pcb, S.chunk, sizeof(S.chunk), TCP_WRITE_FLAG_COPY) != ERR_OK) {
            break;
        }
    }
    tcp_output(f->pcb);
}
err_t sent_cb(void *arg, struct tcp_pcb *, u16_t) { app_send((Flow *)arg); return ERR_OK; }
err_t poll_cb(void *arg, struct tcp_pcb *) { app_send((Flow *)arg); return ERR_OK; } // netconn polls every 2 slow ticks
void err_cb(void *arg, err_t) { S.tcp_errors++; ((Flow *)arg)->pcb = NULL; }
err_t connected_cb(void *arg, struct tcp_pcb *, err_t) { ((Flow *)arg)->connected = true; app_send((Flow *)arg); return ERR_OK; }

// ---- running -------------------------------------------------------------------------------
void send_datagrams(int n)
{
    for (int i = 0; i < n; i++) {
        struct pbuf *p = pbuf_alloc(PBUF_TRANSPORT, 1400, PBUF_RAM);
        ip4_addr_t peer;
        peer.addr = lwip_htonl(PEER_IP);
        udp_sendto(S.upcb, p, &peer, 9);
        pbuf_free(p);
    }
}

void handle(const Ev &ev)
{
    sys_check_timeouts();
    switch (ev.type) {
    case EV_ACK_IN: {
        struct pbuf *p = pbuf_alloc(PBUF_RAW, (u16_t)ev.pkt.size(), PBUF_RAM);
        memcpy(p->payload, ev.pkt.data(), ev.pkt.size());
        if (ip4_input(p, &S.nif) != ERR_OK) {
            pbuf_free(p);
        }
        break;
    }
    case EV_TIMER:
        post(ev.t + TICK, EV_TIMER);
        break;
    case EV_PING: { // an Ethernet ping: lwIP has to take it from its mailbox
        int64_t late = now_us - ev.t;
        if (late > S.ping_max_us) {
            S.ping_max_us = late;
        }
        post(ev.t + 50000, EV_PING);
        break;
    }
    case EV_TXNOW:
        registered_fn(NULL);
        break;
    case EV_BURST: // 12 datagrams of other traffic at once
        send_datagrams(12);
        break;
    case EV_UDP: // a host sends UDP to the device's WiFi address: lwIP answers over WiFi, every 10 ms
        send_datagrams(1);
        if (S.udp_every_us) {
            post(ev.t + S.udp_every_us, EV_UDP);
        }
        break;
    case EV_APP:
        app_send(&S.flow[ev.pkt[0]]);
        break;
    }
}

void run_until(int64_t t_end)
{
    for (;;) {
        int64_t te = S.q.empty() ? INF : S.q.top().t;
        int64_t tn = te < S.tx_done_at ? te : S.tx_done_at;
        if (tn > t_end) {
            break;
        }
        if (S.tx_done_at <= te) {
            if (S.tx_done_at > now_us) {
                now_us = S.tx_done_at;
            }
            do_txdone();
        } else {
            Ev ev = S.q.top();
            S.q.pop();
            if (ev.t > now_us) {
                now_us = ev.t;
            }
            handle(ev);
        }
    }
    if (t_end > now_us) {
        now_us = t_end;
    }
}

// The device, the pool, the netif and 'flows' connections to the peer that are up; time 0 of the run is now
int64_t start(tx_fn_t model, int rtt_ms, int flows = 1)
{
    static bool lwip_up;
    if (!lwip_up) {
        lwip_init();
        lwip_up = true;
    }
    // what the last run left (its aborts send RSTs into the old pool, which is replaced below)
    for (int i = 0; i < MAX_FLOWS; i++) {
        if (S.flow[i].pcb) {
            tcp_err(S.flow[i].pcb, NULL);
            tcp_abort(S.flow[i].pcb);
        }
        S.flow[i] = Flow();
    }
    if (S.nif.name[0]) {
        netif_remove(&S.nif);
    }
    if (S.upcb) {
        udp_remove(S.upcb);
    }
    S.q = std::priority_queue<Ev>();
    delete S.uart;
    dmauart_hw().reset_all();
    memset(&net_counters, 0, sizeof(net_counters));
    memset(&S.ctx, 0, sizeof(S.ctx));
    cmd_buffer_init(&S.ctx);
    S.uart = new DmaUART(&S.regs, 3, NULL, &S.ctx);
    esp32.uart = S.uart;
    wifi.state = eWifi_Connected;
    wifi_tx_wake_init(S.uart);
    txnow_posted = false;
    txnow_posts = 0;
    host_longest_wait_asked = 0;
    host_count_hook = NULL;
    host_queue_wait = block;
    S.tx = model;
    memset(S.chunk, 0x33, sizeof(S.chunk));
    S.evn = 0;
    S.tx_done_at = INF;
    S.stall_from = S.stall_to = 0;
    S.rtt_us = (int64_t)rtt_ms * 1000;
    S.pushes_seen = 0;
    S.cur_frame = NULL;
    S.cur_len = 0;
    S.peer_snd = 7001;
    S.tcp_frames = S.udp_frames = S.dup_segments = 0;
    S.blocked_us = S.longest_block_us = S.ping_max_us = 0;
    S.refused = S.accepted = S.tcp_errors = 0;
    S.udp_every_us = 0;

    // the interface, a UDP socket for other traffic, and the connections
    ip4_addr_t ip, mask, gw;
    ip.addr = lwip_htonl(DEV_IP);
    mask.addr = lwip_htonl(0xFFFFFF00);
    gw.addr = 0;
    memset(&S.nif, 0, sizeof(S.nif));
    netif_add(&S.nif, &ip, &mask, &gw, NULL, sim_netif_init, ip4_input);
    netif_set_up(&S.nif);
    netif_set_default(&S.nif);
    S.upcb = udp_new();

    int64_t t0 = now_us;
    post(t0 + TICK, EV_TIMER);
    post(t0 + 50000, EV_PING);
    S.nflows = flows;
    for (int i = 0; i < flows; i++) {
        Flow &f = S.flow[i];
        f.app_on = true;
        f.pcb = tcp_new();
        tcp_arg(f.pcb, &f);
        tcp_sent(f.pcb, sent_cb);
        tcp_poll(f.pcb, poll_cb, 2);
        tcp_err(f.pcb, err_cb);
        ip4_addr_t peer;
        peer.addr = lwip_htonl(PEER_IP);
        ASSERT_EQ((int)tcp_connect(f.pcb, &peer, PEER_PORT + i, connected_cb), (int)ERR_OK);
    }
    run_until(t0 + 20 * rtt_ms * 1000 + 100000);
    for (int i = 0; i < flows; i++) {
        ASSERT_TRUE(S.flow[i].connected);
        S.flow[i].delivered = 0; // counted from the end of the handshake
    }
    return t0;
}

uint64_t delivered_total()
{
    uint64_t d = 0;
    for (int i = 0; i < S.nflows; i++) {
        d += S.flow[i].delivered;
    }
    return d;
}

// The first TCP data frame of flow 0 taken at or after 't', in microseconds after 't'; -1 for none
int64_t first_accept_after(int64_t t)
{
    const std::vector<int64_t> &a = S.flow[0].accept_times;
    for (size_t i = 0; i < a.size(); i++) {
        if (a[i] >= t) {
            return a[i] - t;
        }
    }
    return -1;
}

struct Result {
    uint64_t delivered;
    int frames, refused, wakes, dup, errors;
    int64_t blocked_us, longest_block_us, ping_max_us;
};
// The counters since 'from' (a result() taken at the start of the measured time)
Result result()
{
    Result r;
    r.delivered = delivered_total();
    r.frames = S.accepted;
    r.refused = S.refused;
    r.wakes = txnow_posts;
    r.dup = S.dup_segments;
    r.errors = S.tcp_errors;
    r.blocked_us = S.blocked_us;
    r.longest_block_us = S.longest_block_us;
    r.ping_max_us = S.ping_max_us;
    return r;
}
Result since(const Result &a, const Result &b)
{
    Result r = b;
    r.delivered -= a.delivered;
    r.frames -= a.frames;
    r.refused -= a.refused;
    r.wakes -= a.wakes;
    r.dup -= a.dup;
    return r;
}
void print(const char *scenario, const char *model, int rtt_ms, int flows, double seconds, const Result &r)
{
    fprintf(stdout,
            "WTXSIM %s model=%s flows=%d rtt=%dms delivered=%llu (%.0f KB/s) frames=%d refused=%d (%.1f/s) wake_posts=%d "
            "dup_segs=%d blocked=%.0fms longest_block=%.0fms ping_max=%.1fms tcp_errors=%d\n",
            scenario, model, flows, rtt_ms, (unsigned long long)r.delivered, r.delivered / 1024.0 / seconds, r.frames,
            r.refused, r.refused / seconds, r.wakes, r.dup, r.blocked_us / 1000.0, r.longest_block_us / 1000.0,
            r.ping_max_us / 1000.0, r.errors);
}

} // namespace

// ---- 1. Throughput, a bulk stream for 10 seconds ---------------------------------------------
// One connection at three round trip times: its 16 KB of send buffer (11 segments) cannot take the
// pool of 12 down to the reserve by itself, so nothing is refused. Two connections can: 22 segments
// for 10 buffers, the case in which the new code refuses frames and the wake has to keep TCP going.
static void throughput(int flows, int rtt, bool expect_refusals)
{
    Result r[2];
    for (int m = 0; m < 2; m++) {
        int64_t t0 = start(m ? new_model : old_model, rtt, flows);
        Result a = result();
        run_until(t0 + 10 * SEC);
        r[m] = since(a, result());
        print("throughput", m ? "new" : "old", rtt, flows, 10.0, r[m]);
    }
    EXPECT_TRUE(r[0].delivered > 100000); // the stream does flow
    double ratio = (double)r[1].delivered / (double)r[0].delivered;
    fprintf(stdout, "WTXSIM throughput flows=%d rtt=%dms new/old delivered = %.4f\n", flows, rtt, ratio);
    EXPECT_TRUE(ratio > 0.97 && ratio < 1.03);
    EXPECT_EQ(r[1].errors, 0);
    EXPECT_EQ(r[1].blocked_us, (int64_t)0);
    if (expect_refusals) {
        EXPECT_TRUE(r[1].refused > 0);
        EXPECT_TRUE(r[1].wakes > 0);
    }
}

TEST(WtxSimThroughput, one_connection_rtt_5)  { throughput(1, 5, false); }
TEST(WtxSimThroughput, one_connection_rtt_30) { throughput(1, 30, false); }
TEST(WtxSimThroughput, one_connection_rtt_60) { throughput(1, 60, false); }
TEST(WtxSimThroughput, two_connections_rtt_5) { throughput(2, 5, true); }
TEST(WtxSimThroughput, two_connections_rtt_30) { throughput(2, 30, false); }

// ---- 2. The module stops draining for 3 seconds ---------------------------------------------
// A bulk stream, and a host that sends UDP to the device's WiFi address every 10 ms (lwIP answers
// over WiFi: the bench leg). From 2 s to 5 s the module does not drain the UART.
TEST(WtxSimStall, lwip_stays_responsive_and_tcp_resumes_with_the_drain)
{
    const int rtt = 30;
    Result r[2];
    int64_t resume_us[2];
    for (int m = 0; m < 2; m++) {
        int64_t t0 = start(m ? new_model : old_model, rtt);
        Result a = result();
        S.udp_every_us = 10000;
        post(now_us + 10000, EV_UDP);
        S.stall_from = t0 + 2 * SEC;
        S.stall_to = t0 + 5 * SEC;
        S.ping_max_us = 0;
        run_until(t0 + 8 * SEC);
        r[m] = since(a, result());
        resume_us[m] = first_accept_after(S.stall_to);
        print("stall", m ? "new" : "old", rtt, 1, 8.0, r[m]);
        fprintf(stdout, "WTXSIM stall model=%s first TCP frame taken after the drain resumed: %.1f ms (RTT %d ms)\n",
                m ? "new" : "old", resume_us[m] / 1000.0, rtt);
    }
    // the old wait: lwIP is stopped for the whole stall (the core lock is held), and so is every ping
    EXPECT_TRUE(r[0].blocked_us > 2900000);
    EXPECT_TRUE(r[0].ping_max_us > 2900000);
    // the new: no wait, every ping is taken in a tick or two (the timer tick is 5 ms), and TCP is
    // taken from the pool as soon as the first frame has left the module: a frame time, not a round trip
    EXPECT_EQ(r[1].blocked_us, (int64_t)0);
    EXPECT_TRUE(r[1].ping_max_us <= 2 * TICK);
    EXPECT_TRUE(r[1].refused > 0);
    EXPECT_TRUE(resume_us[1] >= 0 && resume_us[1] < 10000);
    EXPECT_EQ(r[1].errors, 0);
}

// ---- 3. Nothing in flight, the pool taken by other traffic -----------------------------------
// TCP has nothing outstanding, so no ACK is coming to restart it: after the pool is taken by 12
// datagrams, the segment lwIP was refused is sent when the first datagram has left the module, or, with
// no wake, when lwIP's poll finds it (a second or two)
TEST(WtxSimWake, a_refused_segment_is_sent_when_the_pool_has_room)
{
    const int rtt = 30;
    int64_t first[2];
    for (int m = 0; m < 2; m++) {
        start(m ? new_model : old_model, rtt);
        // quiet: the stream stops, everything is acknowledged
        S.flow[0].app_on = false;
        run_until(now_us + 3 * SEC);
        ASSERT_TRUE(S.flow[0].pcb->unacked == NULL && S.flow[0].pcb->unsent == NULL);
        int refused0 = S.refused;
        int64_t burst = now_us + 10000;
        post(burst, EV_BURST);
        S.flow[0].app_on = true;
        post(burst, EV_APP, std::vector<uint8_t>(1, 0)); // after the datagrams: the application writes again
        run_until(burst + 3 * SEC);
        first[m] = first_accept_after(burst);
        fprintf(stdout, "WTXSIM wake model=%s: TCP frame taken %.1f ms after the other traffic took the pool "
                "(refused %d, wake posts %d)\n", m ? "new" : "old", first[m] / 1000.0, S.refused - refused0, txnow_posts);
        if (m) {
            EXPECT_TRUE(S.refused > refused0); // the segment really was refused
        }
    }
    EXPECT_TRUE(first[0] >= 0 && first[0] < 10000); // the old wait: until a buffer is free
    EXPECT_TRUE(first[1] >= 0 && first[1] < 10000); // the wake: the same
}
